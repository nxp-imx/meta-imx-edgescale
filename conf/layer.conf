## conf/layer.conf
```bitbake
# We have a conf and classes directory, append to BBPATH
BBPATH .= ":${LAYERDIR}"

# We have a recipes directory, add to BBFILES
BBFILES += "${LAYERDIR}/recipes*/*/*.bb ${LAYERDIR}/recipes*/*/*.bbappend"

BBFILE_COLLECTIONS += "imx-edgescale-layer"
BBFILE_PATTERN_imx-edgescale-layer := "^${LAYERDIR}/"
BBFILE_PRIORITY_imx-edgescale-layer = "5"

LAYERSERIES_COMPAT_imx-edgescale-layer = "sumo"

# Add the NXP-specific licenses into the metadata
LICENSE_PATH += "${LAYERDIR}/custom-licenses"

IMAGE_INSTALL_append = " docker docker-registry edgescale-eds eds-bootstrap eds-kubelet"
IMAGE_INSTALL_append = " ethtool dhcp-client curl"

# The default GOVERSION in sumo is 1.9, switch to 1.10 to fix build break
GOVERSION = "1.10%"

HOSTTOOLS_NONFATAL_append = " whoami"
```
